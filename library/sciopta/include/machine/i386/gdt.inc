# -*-asm-*-
######################################################################
##  _______  _______ _________ _______  _______ _________ _______   ##
## (  ____ \(  ____ \\__   __/(  ___  )(  ____ )\__   __/(  ___  )  ##
## | (    \/| (    \/   ) (   | (   ) || (    )|   ) (   | (   ) |  ##
## | (_____ | |         | |   | |   | || (____)|   | |   | (___) |  ##
## (_____  )| |         | |   | |   | ||  _____)   | |   |  ___  |  ##
##       ) || |         | |   | |   | || (         | |   | (   ) |  ##
## /\____) || (____/\___) (___| (___) || )         | |   | )   ( |  ##
## \_______)(_______/\_______/(_______)|/          )_(   |/     \|  ##
##                                                                  ##
## (c) 2002,2003 Sciopta GmbH, Litronic AG/ Schweiz                 ##
##                                                                  ##
######################################################################
## ID: S03076BS6                                                    ##
## +Date: 2008/04/11 07:54:15 +                                     ## 
## +Revision: 1.5 +                                                 ##
## symbols and macros for building descriptors                      ##
######################################################################
# gdt.inc   
# Addapeted for gas by 42Bastian Schick
#
# Version 1.0 March 5, 1998
# Sample code
# by John S. Fine  johnfine#erols.com
# I do not place any restrictions on your use of this source code
# I do not provide any warranty of the correctness of this source code
#_____________________________________________________________________________
#
#  This is a quick kludge to do in a single module program, some of the
#  things that my gdt.inc does in a program linked with JLOC
#_____________________________________________________________________________
#
# The desc macro pieces together a segment descriptor.
#
# desc  offset, selector, flags     #For gate descriptors
# desc  base, limit, flags	    #For all other descriptors
#
#  base    is the full 32 bit base address of the segment
#  limit   is one less than the segment length in 1 or 4K byte units
#  flags   the sum of all the "D_" equates which apply (for call gates, you
#          also add the "parameter dword count" to flags).
#_____________________________________________________________________________

#Each descriptor should have exactly one of next 8 codes to define the type of
#descriptor
D_LDT		=	 0x200	#LDT segment
D_TASK		=	 0x500	#Task gate
D_TSS		=	 0x900	#TSS
D_CALL		=	0x0C00	#386 call gate
D_INT		=	0x0E00	#386 interrupt gate
D_TRAP		=	0x0F00	#386 trap gate
D_DATA		=	0x1000	#Data segment
D_CODE		=	0x1800	#Code segment

#Descriptors may include the following as appropriate:
D_DPL3		=	0x6000	#DPL3 or mask for DPL
D_DPL2		=	0x4000
D_DPL1		=	0x2000
D_PRESENT	=	0x8000	#Present
D_NOT_PRESENT	=	0x8000	#Not Present
				#Note, the PRESENT bit is set by default
				#Include NOT_PRESENT to turn it off
				#Do not specify D_PRESENT

#Segment descriptors (not gates) may include:
D_ACC		=	 0x100	#Accessed (Data or Code)

D_WRITE		=	 0x200	#Writable (Data segments only)
D_READ		=	 0x200	#Readable (Code segments only)
D_BUSY		=	 0x200	#Busy (TSS only)

D_EXDOWN	=	 0x400	#Expand down (Data segments only)
D_CONFORM	=	 0x400	#Conforming (Code segments only)

D_BIG		=	  0x40	#Default to 32 bit mode (USE32)
D_BIG_LIM	=	  0x80	#Limit is in 4K units

	.macro desc start,end,flags
  .if (\flags) & (~(\flags) >> 2) & 0x400
	.word	(\start) & 0xffff
	.word	(\end) & 0xffff
	.word	\flags|D_PRESENT
	.word	(\start) >> 16
  .else
	.word	\end & 0xffff
	.word	\start & 0xffff
	.byte	((\start) >> 16) & 0xff
	.byte	((\flags)>>8) & 0xff
	.byte	(\flags) & 0xf0 + ((\end)>>16) & 0x0f
	.byte	((\start) >> 24) & 0xff
  .endif
	.endm
		
#-----------------------------------------------------------------------------
#
#  A gate is identified as any descriptor whose flags has bit 10 set and 
#  bit 12 clear.
#
#  For a gate, the following rearrangement occurs:
#
#  subField                Final location
#  ------------------      --------------
#  Selector[0..15]             16..31
#  Minor control bits          32..39
#  Major control bits          40..47
#  Offset[0..15]                0..15
#  Offset[16..31]              48..63
#
#  For non-gates the following rearrangement occurs:
#
#  subField                Final location
#  ------------------      --------------
#  Limit[0..15]                 0..15
#  Limit[16..19]               48..51
#  Minor control bits          52..57
#  Major control bits          40..47
#  Base[0..23]                 16..39
#  Base[24..31]                56..63
#
#  The last parameter to the desc macro contains all the control bits
#  combined.  It is generated by adding together the appropriate
#  D_ constants.  For all descriptors, it has the major control bits in D_
#  bits 8 to 15.  The minor control bits are in either D_ bits 0 to 7 or bits
#  4 to 7 depending on the type of descriptor.
#_____________________________________________________________________________

