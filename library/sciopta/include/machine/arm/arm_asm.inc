;********************************************************************
;  _______  _______ _________ _______  _______ _________ _______   **
; (  ____ \(  ____ \\__   __/(  ___  )(  ____ )\__   __/(  ___  )  **
; | (    \/| (    \/   ) (   | (   ) || (    )|   ) (   | (   ) |  **
; | (_____ | |         | |   | |   | || (____)|   | |   | (___) |  **
; (_____  )| |         | |   | |   | ||  _____)   | |   |  ___  |  **
;       ) || |         | |   | |   | || (         | |   | (   ) |  **
; /\____) || (____/\___) (___| (___) || )         | |   | )   ( |  **
; \_______)(_______/\_______/(_______)|/          )_(   |/     \|  **
;                                                                  **
; (c) 2002,2003 Sciopta Systems GmbH, Litronic AG/ Schweiz         **
;                                                                  **
;********************************************************************
; ID: S03217BS1                                                    **
; +Revision: 1.4 +                                                 **
; +Date: 2004/07/05 14:09:45 +                                     **
; CPU definitions                                                  **
;********************************************************************
; generated
PSR_I_BIT	EQU	0x80
PSR_F_BIT	EQU	0x40
	
PSR_MODE_MASK	EQU	0x1F
PSR_SYS_MODE	EQU	0x1F
PSR_USR_MODE	EQU	0x10
PSR_FIQ_MODE	EQU	0x11
PSR_IRQ_MODE	EQU	0x12
PSR_SVC_MODE	EQU	0x13
PSR_ABT_MODE	EQU	0x17
PSR_UND_MODE	EQU	0x1b
	
PSR_THUMB_MODE	EQU	0x20
PSR_THUMB_USER_MODE	EQU	0x30
PSR_THUMB_SYS_MODE	EQU	0x3f
 END
