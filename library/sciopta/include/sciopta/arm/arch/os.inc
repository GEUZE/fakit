;********************************************************************
;  _______  _______ _________ _______  _______ _________ _______   **
; (  ____ \(  ____ \\__   __/(  ___  )(  ____ )\__   __/(  ___  )  **
; | (    \/| (    \/   ) (   | (   ) || (    )|   ) (   | (   ) |  **
; | (_____ | |         | |   | |   | || (____)|   | |   | (___) |  **
; (_____  )| |         | |   | |   | ||  _____)   | |   |  ___  |  **
;       ) || |         | |   | |   | || (         | |   | (   ) |  **
; /\____) || (____/\___) (___| (___) || )         | |   | )   ( |  **
; \_______)(_______/\_______/(_______)|/          )_(   |/     \|  **
;                                                                  **
; (c) 2002,2003 Sciopta Systems GmbH, Litronic AG/ Schweiz         **
;                                                                  **
;********************************************************************
; ID: S02338BS3                                                    **
; +Revision: 1.28 +                                                 **
; +Date: 2008/11/11 10:01:40 +                                     **
; Static kernel configuration                                      **
;********************************************************************
; generated
 ;  CPU types 
ARMv4T	EQU	1
ARMv5T	EQU	2
ARMv5TE	EQU	3
Xscale	EQU	4
ARMv6	EQU	5
ARMv6M	EQU	6
ARMv7	EQU	7
ARMv7M	EQU	8
 END
