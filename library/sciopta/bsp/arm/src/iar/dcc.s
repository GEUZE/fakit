;;SOC -*-asm-*-
;;********************************************************************
;;  _______  _______ _________ _______  _______ _________ _______   **
;; (  ____ \(  ____ \\__   __/(  ___  )(  ____ )\__   __/(  ___  )  **
;; | (    \/| (    \/   ) (   | (   ) || (    )|   ) (   | (   ) |  **
;; | (_____ | |         | |   | |   | || (____)|   | |   | (___) |  **
;; (_____  )| |         | |   | |   | ||  _____)   | |   |  ___  |  **
;;       ) || |         | |   | |   | || (         | |   | (   ) |  **
;; /\____) || (____/\___) (___| (___) || )         | |   | )   ( |  **
;; \_______)(_______/\_______/(_______)|/          )_(   |/     \|  **
;;                                                                  **
;;              (c) 2009 SCIOPTA Systems AG/ Schweiz                **
;;                                                                  **
;;********************************************************************
;; ID: S09224BS3                                                    **
;; +Revision: 1.1.2.1 +                                                 **
;; +Date: 2009/08/12 09:34:55 +                                     **
;; UART using DCC                                                   **
;;********************************************************************
;;EOC


	SECTION .text:CODE(2)
	CODE16

	EXPORT	dcc_getchar
dcc_getchar
	bx	pc
	nop
	CODE32
dcc_getchar1
	mrc	p14, 0, r1, c0, c0
	tst	r1,#1
	beq	dcc_getchar1
	
	mrc	p14, 0, r0, c1, c0
	bx	lr
		
	EXPORT	dcc_putchar
	CODE16	
dcc_putchar
	bx	pc
	nop
	CODE32
dcc_putchar1
	mrc	p14, 0, r1, c0, c0
	tst	r1,#2
	bne	dcc_putchar1
	
	mcr	p14, 0, r0, c1, c0
	bx	lr

	END
